## rtps-r52/Makefile.defconfig
```kconfig
# Set build configuration here
# Drivers
CONFIG_MBOX_LSIO		?= 1
CONFIG_MBOX_HPPS_RTPS		?= 1
CONFIG_RTI_TIMER		?= 1
CONFIG_WDT			?= 1
# Links
CONFIG_LINK_MBOX_TRCH_CLIENT	?= 1
CONFIG_LINK_MBOX_HPPS_SERVER	?= 1
CONFIG_LINK_SHMEM_TRCH_CLIENT	?= 1
CONFIG_LINK_SHMEM_TRCH_SERVER	?= 1
# Additional tasks
CONFIG_SHELL			?= 1

# Enable/disable tests here (some tests require certain CONFIG options):
# Standalone
TEST_COMMAND			?= 1
# TODO: enable SRAM tests when RTEMS sramfs driver aligns with latest BM memfs
TEST_LSIO_SRAM_SYSCFG		?= 0
TEST_LSIO_SRAM_DMA_SYSCFG	?= 0
TEST_MBOX_LSIO_LOOPBACK		?= 1
TEST_RTI_TIMER			?= 1
TEST_RTPS_DMA			?= 1
TEST_RTPS_MMU			?= 1
TEST_SHMEM			?= 1
# Runtime
TEST_COMMAND_SERVER		?= 1
TEST_LINK_SHMEM			?= 1
# External
TEST_MBOX_LINK_TRCH		?= 1
TEST_SHMEM_LINK_TRCH		?= 1
```
